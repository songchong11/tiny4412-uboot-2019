// SPDX-License-Identifier: GPL-2.0+
/*
 * Samsung's Exynos4210 based Origen board device tree source
 *
 * Copyright (c) 2014 Samsung Electronics Co., Ltd.
 *		http://www.samsung.com
 */

/dts-v1/;
#include "skeleton.dtsi"
#include "exynos4412.dtsi"

/ {
	model = "Insignal Tiny4412 evaluation board based on Exynos4412";
	compatible = "insignal,tiny4412", "samsung,exynos4412";

	chosen {
		bootargs ="";
		stdout-path="serial0"
	};
    serial0:serial@13810000 {
		   status = "okay";
    };
	aliases {
		serial0 = "/serial@13800000";
		console = "/serial@13800000";
	};
};

&sdhci2 {
	samsung,bus-width = <4>;
	samsung,timing = <1 2 3>;
	cd-gpios = <&gpk2 2 0>;
	status = "okay";
};
