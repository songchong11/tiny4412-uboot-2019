## board/samsung/tiny4412/Kconfig
```kconfig
if TARGET_TINY4412

config TINY4412
	default y
	bool "For CONFIG_TINY4412"

config SYS_BOARD
	default "tiny4412"

config SYS_VENDOR
	default "samsung"

config SYS_CONFIG_NAME
	default "tiny4412"

endif
```
